## firmware/sdkconfig.defaults
```kconfig
# Enable USB OTG CDC-ACM Port in esp-serial-flasher Kconfig
CONFIG_SERIAL_FLASHER_PORT_USB_CDC_ACM=y
CONFIG_SERIAL_FLASHER_PORT_UART=n
CONFIG_SERIAL_FLASHER_PORT_SPI=n
CONFIG_SERIAL_FLASHER_PORT_SDIO=n
```
